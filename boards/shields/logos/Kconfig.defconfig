## boards/shields/logos/Kconfig.defconfig
```kconfig
if SHIELD_LOGOS_LEFT

# Name must be less than 16 characters long!
config ZMK_KEYBOARD_NAME
    default "logos"

config ZMK_SPLIT_ROLE_CENTRAL
    default y

endif

if SHIELD_LOGOS_LEFT || SHIELD_LOGOS_RIGHT

config ZMK_SPLIT
    default y

endif
```

## boards/shields/logos/Kconfig.shield
```kconfig
# No whitespace after the comma or in your part name!
config SHIELD_LOGOS_LEFT
    def_bool $(shields_list_contains,logos_left)

# No whitespace after the comma or in your part name!
config SHIELD_LOGOS_RIGHT
    def_bool $(shields_list_contains,logos_right)
```

## west.yml
```yaml
manifest:
  remotes:
    - name: brichar01
      url-base: https://github.com/brichar01
  projects:
    # Together with the above defined remote, this refers to a module located at
    # https://github.com/remote-name/repository-name
    - name: zmk-shield-logos
      remote: brichar01 
      # This points to a west manifest file in the remote module for further imports
      import: west.yml
```
